## conf/layer.conf
```bitbake
# We have a conf and classes directory, add to BBPATH
BBPATH .= ":${LAYERDIR}"

# We have recipes-* directories, add to BBFILES
BBFILES += "${LAYERDIR}/recipes-*/*/*.bb \
            ${LAYERDIR}/recipes-*/*/*.bbappend"

BBFILE_COLLECTIONS += "mediatek"
BBFILE_PATTERN_mediatek = "^${LAYERDIR}/"
BBFILE_PRIORITY_mediatek = "10"
LAYERSERIES_COMPAT_mediatek = "thud"
```

## conf/machine/mt7620.conf
```bitbake
#@TYPE: Machine
#@NAME: mt7620
#@DESCRIPTION: MIPS 32r2, Little Endian, Hard Float

require conf/machine/include/qemu.inc
require conf/machine/include/qemuboot-mips.inc
require conf/machine/include/tune-mips32r2.inc
require mips-common.inc

DEFAULTTUNE = "mips32r2el"

MACHINE_FEATURES = "kernel26 apm alsa ext2 ext3 usbhost ppp wifi serial vfat"
MACHINE_EXTRA_RRECOMMENDS = " kernel-modules kernel-devicetree"
# IMAGE_INSTALL_append = " kernel-devicetree"

PREFERRED_PROVIDER_virtual/kernel = "linux-yocto"
PREFERRED_VERSION_virtual/kernel = "4.10%"

# kernel-image
KERNEL_IMAGETYPE = "uImage"
# KERNEL_ALT_IMAGETYPE = "vmlinux"
KERNEL_IMAGE_STRIP_EXTRA_SECTIONS  = ".comment"

# used by sysvinit_2
SERIAL_CONSOLES ?= "115200;ttyS1"
SERIAL_CONSOLE = "115200 ttyS1"
USE_VT ?= "0"


PREFERRED_PROVIDER_virtual/bootloader = "u-boot-mt7620"
UBOOT_MACHINE = "mt7260_config"
UBOOT_ENTRYPOINT = "0x20008000"
UBOOT_LOADADDRESS = "0x20008000"

PREFERRED_PROVIDER_jpeg = "jpeg"
PREFERRED_PROVIDER_jpeg-native = "jpeg-native"

ROOT_FLASH_SIZE = "256"
IMAGE_FSTYPES += " ubi tar.gz"

# NAND
MKUBIFS_ARGS = " -e 0x1f000 -c 2048 -m 0x800  -x lzo"
UBINIZE_ARGS = " -m 0x800 -p 0x20000 -s 2048"

UBI_VOLNAME = "rootfs"
```

## conf/machine/mt7688.conf
```bitbake
#@TYPE: Machine
#@NAME: mt7688
#@DESCRIPTION: MIPS 32r2, Little Endian, Soft Float

require conf/machine/include/qemu.inc
require conf/machine/include/qemuboot-mips.inc
require conf/machine/include/mips/tune-mips-24k.inc

DEFAULTTUNE = "mips32r2el-24kc"

MACHINE_FEATURES = "wifi serial"
MACHINE_EXTRA_RRECOMMENDS = " kernel-modules kernel-devicetree"

PREFERRED_PROVIDER_virtual/kernel = "linux-yocto-dev"

KERNEL_CLASSES += "kernel-fitimage"
KERNEL_IMAGETYPE ?= "fitImage"

KERNEL_DEVICETREE_mt7688 = "gardena_smart_gateway_mt7688.dtb"

# used by sysvinit_2 and systemd
SERIAL_CONSOLES ?= "115200;ttyS0"

PREFERRED_VERSION_u-boot = "v2019.01-rc2-mt7688-2018-12-18-gardena"
PREFERRED_VERSION_u-boot-fw-utils = "v2019.01-rc2-mt7688-2018-12-18-gardena"
UBOOT_CONFIG ??= "rom"
UBOOT_CONFIG[rom] = "gardena-smart-gateway-mt7688_defconfig"
UBOOT_ENTRYPOINT="0x80000400"
UBOOT_LOADADDRESS="0x80000000"

RADIO_MODULE_PPP_TTY = "/dev/ttyS1"
```

## recipes-kernel/linux/linux-yocto-dev/mt7688/defconfig
```kconfig
CONFIG_TASKSTATS=y
CONFIG_TASK_DELAY_ACCT=y
CONFIG_TASK_XACCT=y
CONFIG_TASK_IO_ACCOUNTING=y
CONFIG_IKCONFIG=y
CONFIG_IKCONFIG_PROC=y
CONFIG_NAMESPACES=y
CONFIG_CC_OPTIMIZE_FOR_SIZE=y
CONFIG_EMBEDDED=y
CONFIG_RALINK=y
CONFIG_SOC_MT7620=y
CONFIG_DTB_GARDENA_SMART_GATEWAY_MT7688=y
CONFIG_CPU_MIPS32_R2=y
CONFIG_MIPS_CMDLINE_DTB_EXTEND=y
CONFIG_PACKET=y
CONFIG_UNIX=y
CONFIG_INET=y
CONFIG_IP_PNP=y
CONFIG_NETFILTER=y
CONFIG_NF_CONNTRACK=m
CONFIG_NF_CONNTRACK_AMANDA=m
CONFIG_NF_CONNTRACK_FTP=m
CONFIG_NF_CONNTRACK_H323=m
CONFIG_NF_CONNTRACK_IRC=m
CONFIG_NF_CONNTRACK_NETBIOS_NS=m
CONFIG_NF_CONNTRACK_PPTP=m
CONFIG_NF_CONNTRACK_SANE=m
CONFIG_NF_CONNTRACK_SIP=m
CONFIG_NF_CONNTRACK_TFTP=m
CONFIG_NF_CT_NETLINK=m
CONFIG_NETFILTER_XT_TARGET_CLASSIFY=m
CONFIG_NETFILTER_XT_TARGET_CONNMARK=m
CONFIG_NETFILTER_XT_TARGET_DSCP=m
CONFIG_NETFILTER_XT_TARGET_MARK=m
CONFIG_NETFILTER_XT_TARGET_NFLOG=m
CONFIG_NETFILTER_XT_TARGET_NFQUEUE=m
CONFIG_NETFILTER_XT_TARGET_NOTRACK=m
CONFIG_NETFILTER_XT_TARGET_TRACE=m
CONFIG_NETFILTER_XT_TARGET_TCPMSS=m
CONFIG_NETFILTER_XT_MATCH_COMMENT=m
CONFIG_NETFILTER_XT_MATCH_CONNBYTES=m
CONFIG_NETFILTER_XT_MATCH_CONNLIMIT=m
CONFIG_NETFILTER_XT_MATCH_CONNMARK=m
CONFIG_NETFILTER_XT_MATCH_CONNTRACK=m
CONFIG_NETFILTER_XT_MATCH_DCCP=m
CONFIG_NETFILTER_XT_MATCH_DSCP=m
CONFIG_NETFILTER_XT_MATCH_ESP=m
CONFIG_NETFILTER_XT_MATCH_HASHLIMIT=m
CONFIG_NETFILTER_XT_MATCH_HELPER=m
CONFIG_NETFILTER_XT_MATCH_LENGTH=m
CONFIG_NETFILTER_XT_MATCH_LIMIT=m
CONFIG_NETFILTER_XT_MATCH_MAC=m
CONFIG_NETFILTER_XT_MATCH_MARK=m
CONFIG_NETFILTER_XT_MATCH_MULTIPORT=m
CONFIG_NETFILTER_XT_MATCH_PKTTYPE=m
CONFIG_NETFILTER_XT_MATCH_QUOTA=m
CONFIG_NETFILTER_XT_MATCH_REALM=m
CONFIG_NETFILTER_XT_MATCH_SCTP=m
CONFIG_NETFILTER_XT_MATCH_STATE=m
CONFIG_NETFILTER_XT_MATCH_STATISTIC=m
CONFIG_NETFILTER_XT_MATCH_STRING=m
CONFIG_NETFILTER_XT_MATCH_TCPMSS=m
CONFIG_NETFILTER_XT_MATCH_U32=m
CONFIG_IP_NF_IPTABLES=m
CONFIG_IP_NF_MATCH_AH=m
CONFIG_IP_NF_MATCH_ECN=m
CONFIG_IP_NF_MATCH_RPFILTER=m
CONFIG_IP_NF_MATCH_TTL=m
CONFIG_IP_NF_FILTER=m
CONFIG_IP_NF_TARGET_REJECT=m
CONFIG_IP_NF_TARGET_SYNPROXY=m
CONFIG_IP_NF_NAT=m
CONFIG_IP_NF_TARGET_MASQUERADE=m
CONFIG_IP_NF_TARGET_NETMAP=m
CONFIG_IP_NF_TARGET_REDIRECT=m
CONFIG_IP_NF_MANGLE=m
CONFIG_IP_NF_TARGET_CLUSTERIP=m
CONFIG_IP_NF_TARGET_ECN=m
CONFIG_IP_NF_TARGET_TTL=m
CONFIG_IP_NF_RAW=m
CONFIG_IP_NF_ARPTABLES=m
CONFIG_IP_NF_ARPFILTER=m
CONFIG_IP_NF_ARP_MANGLE=m
CONFIG_NET_SCHED=y
CONFIG_DEVTMPFS_MOUNT=y
CONFIG_FW_LOADER=m
CONFIG_MTD=y
CONFIG_MTD_CMDLINE_PARTS=y
CONFIG_MTD_M25P80=y
CONFIG_MTD_SPI_NAND=y
CONFIG_MTD_SPI_NOR=y
CONFIG_MTD_UBI=y
CONFIG_MTD_UBI_BEB_LIMIT=22
CONFIG_MTD_UBI_BLOCK=y
CONFIG_UBOOT_BOOTCOUNT=y
CONFIG_NETDEVICES=y
CONFIG_PHYLIB=y
CONFIG_SWCONFIG=y
CONFIG_DEVKMEM=y
CONFIG_TTY_PRINTK=y
CONFIG_HW_RANDOM=y
CONFIG_I2C=y
CONFIG_I2C_CHARDEV=y
CONFIG_SPI=y
CONFIG_GPIOLIB=y
CONFIG_GPIO_SYSFS=y
CONFIG_MT7621_WDT=y
CONFIG_MFD_SYSCON=y
CONFIG_PWM=y
CONFIG_GENERIC_PHY=y
CONFIG_OVERLAY_FS=y
CONFIG_CONFIGFS_FS=y
CONFIG_NFS_V4=y
CONFIG_NLS=y
CONFIG_CRYPTO_AUTHENC=y
CONFIG_PRINTK_TIME=y
CONFIG_POSIX_TIMERS=y
```

## recipes-kernel/linux/linux-yocto-tiny/mt7688/defconfig
```kconfig
CONFIG_TASKSTATS=y
CONFIG_TASK_DELAY_ACCT=y
CONFIG_TASK_XACCT=y
CONFIG_TASK_IO_ACCOUNTING=y
CONFIG_IKCONFIG=y
CONFIG_IKCONFIG_PROC=y
CONFIG_NAMESPACES=y
CONFIG_CC_OPTIMIZE_FOR_SIZE=y
CONFIG_EMBEDDED=y
CONFIG_RALINK=y
CONFIG_SOC_MT7620=y
CONFIG_CPU_MIPS32_R2=y
CONFIG_MIPS_CMDLINE_DTB_EXTEND=y
CONFIG_PACKET=y
CONFIG_UNIX=y
CONFIG_INET=y
CONFIG_IP_PNP=y
CONFIG_NET_SCHED=y
CONFIG_FW_LOADER=m
CONFIG_MTD=y
CONFIG_MTD_CMDLINE_PARTS=y
CONFIG_MTD_M25P80=y
CONFIG_MTD_SPI_NAND=y
CONFIG_MTD_SPI_NOR=y
CONFIG_MTD_UBI=y
CONFIG_MTD_UBI_BEB_LIMIT=22
CONFIG_MTD_UBI_BLOCK=y
CONFIG_UBOOT_BOOTCOUNT=y
CONFIG_NETDEVICES=y
CONFIG_PHYLIB=y
CONFIG_SWCONFIG=y
CONFIG_DEVKMEM=y
CONFIG_TTY_PRINTK=y
CONFIG_HW_RANDOM=y
CONFIG_I2C=y
CONFIG_I2C_CHARDEV=y
CONFIG_SPI=y
CONFIG_GPIOLIB=y
CONFIG_GPIO_SYSFS=y
CONFIG_MT7621_WDT=y
CONFIG_MFD_SYSCON=y
CONFIG_PWM=y
CONFIG_GENERIC_PHY=y
CONFIG_OVERLAY_FS=y
CONFIG_CONFIGFS_FS=y
CONFIG_NFS_V4=y
CONFIG_NLS=y
CONFIG_CRYPTO_AUTHENC=y
CONFIG_PRINTK_TIME=y
CONFIG_POSIX_TIMERS=y
```
